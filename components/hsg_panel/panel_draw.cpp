#include "panel_draw.h"
#include "panel_hw.h"
#include "esp_lcd_panel_ops.h"
#include <string.h>

#if defined(BOARD_OLIMEX_POE)

static esp_lcd_panel_handle_t s_panel;

/* Public-domain 8x8 (font8x8_basic), ASCII 32..126 */
static const uint8_t s_font8x8[95][8] = {
    {0x00,0x00,0x00,0x00,0x00,0x00,0x00,0x00},
    {0x18,0x3C,0x3C,0x18,0x18,0x00,0x18,0x00},
    {0x36,0x36,0x00,0x00,0x00,0x00,0x00,0x00},
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    {0x6E,0x3B,0x00,0x00,0x00,0x00,0x00,0x00},
};

void panel_draw_init(esp_lcd_panel_handle_t panel)
{
    s_panel = panel;
}

int panel_draw_char_width(void) { return 8 * PANEL_FONT_SCALE; }
int panel_draw_char_height(void) { return 8 * PANEL_FONT_SCALE; }

int panel_draw_text_width(const char *s)
{
    if (!s) return 0;
    int n = 0;
    while (s[n]) ++n;
    return n * panel_draw_char_width();
}

void panel_draw_fill_rect(int x, int y, int w, int h, uint16_t color)
{
    if (!s_panel || w <= 0 || h <= 0) return;
    if (x < 0) { w += x; x = 0; }
    if (y < 0) { h += y; y = 0; }
    if (x + w > PANEL_W) w = PANEL_W - x;
    if (y + h > PANEL_H) h = PANEL_H - y;
    if (w <= 0 || h <= 0) return;

    /* Multi-row chunks: fewer SPI transactions, one in-flight buffer at a time. */
    static const int k_chunk = 40;
    static uint16_t chunk[PANEL_W * k_chunk];

    for (int row0 = 0; row0 < h; row0 += k_chunk) {
        const int rows = (h - row0) < k_chunk ? (h - row0) : k_chunk;
        for (int r = 0; r < rows; ++r) {
            uint16_t *dst = chunk + (r * w);
            for (int i = 0; i < w; ++i) {
                dst[i] = color;
            }
        }
        panel_hw_draw_bitmap(x, y + row0, x + w, y + row0 + rows, chunk);
    }
}

void panel_draw_clear(uint16_t color)
{
    panel_draw_fill_rect(0, 0, PANEL_W, PANEL_H, color);
}

void panel_draw_rect_outline(int x, int y, int w, int h, uint16_t color)
{
    if (w <= 0 || h <= 0) return;
    panel_draw_fill_rect(x, y, w, 1, color);
    panel_draw_fill_rect(x, y + h - 1, w, 1, color);
    panel_draw_fill_rect(x, y, 1, h, color);
    panel_draw_fill_rect(x + w - 1, y, 1, h, color);
}

void panel_draw_circle_fill(int cx, int cy, int r, uint16_t color)
{
    if (r <= 0) return;
    static uint16_t line[PANEL_W];

    for (int dy = -r; dy <= r; ++dy) {
        int dx_max = 0;
        while (dx_max * dx_max + dy * dy <= r * r) {
            ++dx_max;
        }
        --dx_max;
        if (dx_max < 0) continue;

        const int x0 = cx - dx_max;
        const int w = 2 * dx_max + 1;
        if (x0 < 0 || cy + dy < 0 || x0 + w > PANEL_W || cy + dy >= PANEL_H) {
            continue;
        }
        for (int i = 0; i < w; ++i) {
            line[i] = color;
        }
        panel_hw_draw_bitmap(x0, cy + dy, x0 + w, cy + dy + 1, line);
    }
}

void panel_draw_circle_outline(int cx, int cy, int r, uint16_t color)
{
    if (r <= 0) return;
    int x = r;
    int y = 0;
    int err = 0;
    while (x >= y) {
        panel_draw_fill_rect(cx + x, cy + y, 1, 1, color);
        panel_draw_fill_rect(cx + y, cy + x, 1, 1, color);
        panel_draw_fill_rect(cx - y, cy + x, 1, 1, color);
        panel_draw_fill_rect(cx - x, cy + y, 1, 1, color);
        panel_draw_fill_rect(cx - x, cy - y, 1, 1, color);
        panel_draw_fill_rect(cx - y, cy - x, 1, 1, color);
        panel_draw_fill_rect(cx + y, cy - x, 1, 1, color);
        panel_draw_fill_rect(cx + x, cy - y, 1, 1, color);
        ++y;
        err += 1 + 2 * y;
        if (2 * (err - x) + 1 > 0) {
            --x;
            err += 1 - 2 * x;
        }
    }
}

void panel_draw_cross(int cx, int cy, int arm, uint16_t color)
{
    if (arm <= 0) return;
    panel_draw_fill_rect(cx - arm, cy, 2 * arm + 1, 1, color);
    panel_draw_fill_rect(cx, cy - arm, 1, 2 * arm + 1, color);
}

static void draw_text_run(int x, int y, const char *s,
                          uint16_t fg, uint16_t bg, int cell_px)
{
    if (!s || !s_panel) return;
    if (cell_px < 8) cell_px = 8;
    if (cell_px > 24) cell_px = 24;
    if (x < 0 || y < 0 || y + cell_px > PANEL_H) return;

    int count = 0;
    while (s[count] && x + (count + 1) * cell_px <= PANEL_W) {
        ++count;
    }
    if (count <= 0) return;

    const int width = count * cell_px;
    static uint16_t text_buf[PANEL_W * 24];

    for (int ci = 0; ci < count; ++ci) {
        char c = s[ci];
        if (c < 32 || c > 126) c = '?';
        const uint8_t *g = s_font8x8[(int)c - 32];

        for (int dy = 0; dy < cell_px; ++dy) {
            const int src_row = (dy * 8) / cell_px;
            const uint8_t bits = g[src_row];
            uint16_t *dst = text_buf + dy * width + ci * cell_px;
            for (int dx = 0; dx < cell_px; ++dx) {
                /* Font storage is mirrored relative to panel coordinates. */
                const int displayed_col = (dx * 8) / cell_px;
                const int source_col = 7 - displayed_col;
                dst[dx] = (bits & (0x80u >> source_col)) ? fg : bg;
            }
        }
    }

    panel_hw_draw_bitmap(x, y, x + width, y + cell_px, text_buf);
}

void panel_draw_text_scaled(int x, int y, const char *s, uint16_t fg, uint16_t bg, int scale)
{
    if (scale < 1) scale = 1;
    if (scale > 3) scale = 3;
    draw_text_run(x, y, s, fg, bg, 8 * scale);
}

void panel_draw_text_px(int x, int y, const char *s, uint16_t fg, uint16_t bg, int cell_px)
{
    draw_text_run(x, y, s, fg, bg, cell_px);
}

void panel_draw_text(int x, int y, const char *s, uint16_t fg, uint16_t bg)
{
    panel_draw_text_scaled(x, y, s, fg, bg, PANEL_FONT_SCALE);
}

void panel_draw_text_centered(int y, const char *s, uint16_t fg, uint16_t bg)
{
    if (!s) return;
    int x = (PANEL_W - panel_draw_text_width(s)) / 2;
    if (x < 0) x = 0;
    panel_draw_text(x, y, s, fg, bg);
}

void panel_draw_text_in_row(int y, int row_h, int x, const char *s, uint16_t fg, uint16_t bg)
{
    panel_draw_fill_rect(0, y, PANEL_W, row_h, bg);
    int ty = y + (row_h - panel_draw_char_height()) / 2;
    if (ty < y) ty = y;
    panel_draw_text(x, ty, s, fg, bg);
}

#else

void panel_draw_init(esp_lcd_panel_handle_t panel) { (void)panel; }
void panel_draw_clear(uint16_t color) { (void)color; }
void panel_draw_fill_rect(int x, int y, int w, int h, uint16_t color)
{ (void)x; (void)y; (void)w; (void)h; (void)color; }
void panel_draw_rect_outline(int x, int y, int w, int h, uint16_t color)
{ (void)x; (void)y; (void)w; (void)h; (void)color; }
void panel_draw_circle_outline(int cx, int cy, int r, uint16_t color)
{ (void)cx; (void)cy; (void)r; (void)color; }
void panel_draw_circle_fill(int cx, int cy, int r, uint16_t color)
{ (void)cx; (void)cy; (void)r; (void)color; }
void panel_draw_cross(int cx, int cy, int arm, uint16_t color)
{ (void)cx; (void)cy; (void)arm; (void)color; }
void panel_draw_text(int x, int y, const char *s, uint16_t fg, uint16_t bg)
{ (void)x; (void)y; (void)s; (void)fg; (void)bg; }
void panel_draw_text_scaled(int x, int y, const char *s, uint16_t fg, uint16_t bg, int scale)
{ (void)x; (void)y; (void)s; (void)fg; (void)bg; (void)scale; }
void panel_draw_text_px(int x, int y, const char *s, uint16_t fg, uint16_t bg, int cell_px)
{ (void)x; (void)y; (void)s; (void)fg; (void)bg; (void)cell_px; }
void panel_draw_text_centered(int y, const char *s, uint16_t fg, uint16_t bg)
{ (void)y; (void)s; (void)fg; (void)bg; }
void panel_draw_text_in_row(int y, int row_h, int x, const char *s, uint16_t fg, uint16_t bg)
{ (void)y; (void)row_h; (void)x; (void)s; (void)fg; (void)bg; }
int panel_draw_char_width(void) { return 8 * PANEL_FONT_SCALE; }
int panel_draw_char_height(void) { return 8 * PANEL_FONT_SCALE; }
int panel_draw_text_width(const char *s) { (void)s; return 0; }

#endif
